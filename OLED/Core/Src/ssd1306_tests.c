#include <string.h>
#include <stdio.h>
#include "ssd1306.h"
#include "ssd1306_tests.h"
#include "ssd1306_fonts.h"
#include <stdbool.h> // Include the stdbool.h header

#include "stm32l4xx_hal.h"

//// Define the GPIO pins for left and right buttons
//#define LEFT_BUTTON_PIN GPIO_PIN_0
//#define RIGHT_BUTTON_PIN GPIO_PIN_1
//#define BUTTON_GPIO_PORT GPIOA
//
//#include "stm32l4xx_hal.h"
//
//// Global variable to track the state of PC13
//GPIO_PinState PC13_state = GPIO_PIN_RESET;
//
//// Function to read the state of PC13
//void readPC13State() {
//    PC13_state = HAL_GPIO_ReadPin(GPIOC, GPIO_PIN_13);
//}
//
//// Function to move paddle left based on PC13 state
//bool movePaddleLeft() {
//    readPC13State(); // Read PC13 state
//    return (PC13_state == GPIO_PIN_SET); // Return true if PC13 is pressed
//}
//
//// Function to move paddle right based on PC13 state
//bool movePaddleRight() {
//    readPC13State(); // Read PC13 state
//    return (PC13_state == GPIO_PIN_RESET); // Return true if PC13 is not pressed
//}



//------------------------------------------------------------------------------
// Table generated by LCD Assistant
// http://en.radzio.dxp.pl/bitmap_converter/
//------------------------------------------------------------------------------
const unsigned char garfield_128x64 [] = {
0x00, 0x00, 0x00, 0x00, 0x00, 0x00, 0x00, 0x00, 0x00, 0x00, 0x00, 0x00, 0x00, 0x00, 0x00, 0x00,
0x00, 0x00, 0x00, 0x00, 0x00, 0x07, 0xFF, 0x00, 0x00, 0x00, 0x00, 0x00, 0x00, 0x00, 0x00, 0x00,
0x00, 0x00, 0x00, 0x00, 0x00, 0x1F, 0xFF, 0xF8, 0x7F, 0xE0, 0x00, 0x00, 0x00, 0x00, 0x00, 0x00,
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0x00, 0x00, 0x00, 0x00, 0x00, 0x03, 0xFF, 0xE0, 0xC0, 0x3F, 0x9E, 0x00, 0x00, 0x00, 0x00, 0x00
};

const unsigned char github_logo_64x64[] = {
0x00, 0x00, 0x00, 0x1F, 0xF8, 0x00, 0x00, 0x00, 0x00, 0x00, 0x03, 0xFF, 0xFF, 0x80, 0x00, 0x00,
0x00, 0x00, 0x0F, 0xFF, 0xFF, 0xF0, 0x00, 0x00, 0x00, 0x00, 0x3F, 0xFF, 0xFF, 0xFC, 0x00, 0x00,
0x00, 0x00, 0xFF, 0xFF, 0xFF, 0xFF, 0x00, 0x00, 0x00, 0x03, 0xFF, 0xFF, 0xFF, 0xFF, 0xC0, 0x00,
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0x00, 0x00, 0x00, 0x00, 0x00, 0x00, 0x00, 0x00, 0x00, 0x00, 0x00, 0x00, 0x00, 0x00, 0x00, 0x00
};

void ssd1306_TestBorder() {
    ssd1306_Fill(Black);

    uint8_t x = 0;
    uint8_t y = 0;
    do {
        ssd1306_DrawPixel(x, y, Black);

        if((y == 0) && (x < (SSD1306_WIDTH-1)))
            x++;
        else if((x == (SSD1306_WIDTH-1)) && (y < (SSD1306_HEIGHT-1)))
            y++;
        else if((y == (SSD1306_HEIGHT-1)) && (x > 0))
            x--;
        else
            y--;

        ssd1306_DrawPixel(x, y, White);
        ssd1306_UpdateScreen();

        HAL_Delay(5);
    } while(x > 0 || y > 0);

    HAL_Delay(1000);
}

void ssd1306_TestFonts1() {
    uint8_t y = 0;
    ssd1306_Fill(Black);

    #ifdef SSD1306_INCLUDE_FONT_16x26
    ssd1306_SetCursor(2, y);
    ssd1306_WriteString("Font 16x26", Font_16x26, White);
    y += 26;
    #endif

    #ifdef SSD1306_INCLUDE_FONT_11x18
    ssd1306_SetCursor(2, y);
    ssd1306_WriteString("Font 11x18", Font_11x18, White);
    y += 18;
    #endif

    #ifdef SSD1306_INCLUDE_FONT_7x10
    ssd1306_SetCursor(2, y);
    ssd1306_WriteString("Font 7x10", Font_7x10, White);
    y += 10;
    #endif

    #ifdef SSD1306_INCLUDE_FONT_6x8
    ssd1306_SetCursor(2, y);
    ssd1306_WriteString("Font 6x8", Font_6x8, White);
    #endif

    ssd1306_UpdateScreen();
}

/*
 * This test shows how an 128x64 px OLED can replace a 0802 LCD.
 */
void ssd1306_TestFonts2() {
#ifdef SSD1306_INCLUDE_FONT_16x24
    uint8_t x1, y1, x2, y2;

    ssd1306_Fill(Black);

    ssd1306_SetCursor(0, 4);
    ssd1306_WriteString("18.092.5", Font_16x24, White);
    ssd1306_SetCursor(0, 4+24+8);
    ssd1306_WriteString("RIT+1000", Font_16x24, White);

    // underline
    x1 = 6*16;
    y1 = 4+24+8+24;
    x2 = x1+16;
    y2 = y1+2;
    ssd1306_FillRectangle(x1, y1, x2, y2, White);

    ssd1306_UpdateScreen();
#endif
}

/*
 * Test of proportional (non-monospaced) font.
 */
void ssd1306_TestFonts3() {
    ssd1306_Fill(Black);
#ifdef SSD1306_INCLUDE_FONT_16x15
    ssd1306_SetCursor(4, 4);
    ssd1306_WriteString("Proportional", Font_16x15, White);
    ssd1306_SetCursor(4, 24);
    ssd1306_WriteString("text... Sweet!", Font_16x15, White);
    ssd1306_SetCursor(4, 44);
    ssd1306_WriteString("3.1415  04:20", Font_16x15, White);
#elif defined(SSD1306_INCLUDE_FONT_11x18)
    ssd1306_SetCursor(4, 4);
    ssd1306_WriteString("Skip test", Font_11x18, White);
    ssd1306_SetCursor(4, 24);
    ssd1306_WriteString("Font not", Font_11x18, White);
    ssd1306_SetCursor(4, 44);
    ssd1306_WriteString("included!", Font_11x18, White);
#endif
    ssd1306_UpdateScreen();
}

void ssd1306_TestFPS() {
    ssd1306_Fill(White);

    uint32_t start = HAL_GetTick();
    uint32_t end = start;
    int fps = 0;
    char message[] = "ABCDEFGHIJK";

    ssd1306_SetCursor(2,0);
    ssd1306_WriteString("Testing...", Font_11x18, Black);
    ssd1306_SetCursor(2, 18*2);
    ssd1306_WriteString("0123456789A", Font_11x18, Black);

    do {
        ssd1306_SetCursor(2, 18);
        ssd1306_WriteString(message, Font_11x18, Black);
        ssd1306_UpdateScreen();

        char ch = message[0];
        memmove(message, message+1, sizeof(message)-2);
        message[sizeof(message)-2] = ch;

        fps++;
        end = HAL_GetTick();
    } while((end - start) < 5000);

    HAL_Delay(5000);

    char buff[64];
    fps = (float)fps / ((end - start) / 1000.0);
    snprintf(buff, sizeof(buff), "~%d FPS", fps);

    ssd1306_Fill(White);
    ssd1306_SetCursor(2, 2);
    ssd1306_WriteString(buff, Font_11x18, Black);
    ssd1306_UpdateScreen();
}

void ssd1306_TestLine() {

  ssd1306_Line(1,1,SSD1306_WIDTH - 1,SSD1306_HEIGHT - 1,White);
  ssd1306_Line(SSD1306_WIDTH - 1,1,1,SSD1306_HEIGHT - 1,White);
  ssd1306_UpdateScreen();
  return;
}

void ssd1306_TestRectangle() {
  uint32_t delta;

  for(delta = 0; delta < 5; delta ++) {
    ssd1306_DrawRectangle(1 + (5*delta),1 + (5*delta) ,SSD1306_WIDTH-1 - (5*delta),SSD1306_HEIGHT-1 - (5*delta),White);
  }
  ssd1306_UpdateScreen();
  return;
}

void ssd1306_TestRectangleFill() {
  ssd1306_FillRectangle(31, 1, 65, 35, White);
  ssd1306_FillRectangle(10, 45, 70, 60, White);
  ssd1306_FillRectangle(75, 10, 100, 45, White);
  ssd1306_FillRectangle(55, 30, 80, 55, Black);
  ssd1306_UpdateScreen();
}

void ssd1306_TestRectangleInvert() {
#ifdef SSD1306_INCLUDE_FONT_11x18
  ssd1306_SetCursor(2, 0);
  ssd1306_WriteString("Black", Font_11x18, White);
  ssd1306_SetCursor(2, 20);
  ssd1306_WriteString("on", Font_11x18, White);
  ssd1306_SetCursor(2, 40);
  ssd1306_WriteString("White", Font_11x18, White);
  ssd1306_SetCursor(66, 0);
  ssd1306_WriteString("White", Font_11x18, White);
  ssd1306_SetCursor(66, 20);
  ssd1306_WriteString("on", Font_11x18, White);
  ssd1306_SetCursor(66, 40);
  ssd1306_WriteString("Black", Font_11x18, White);
#else
  ssd1306_FillCircle(32, 32, 20, White);
  ssd1306_FillCircle(96, 32, 20, White);
#endif
  ssd1306_InvertRectangle(0,0,63,63);
  /* Test rectangle lies on one 8px page */
  ssd1306_InvertRectangle(2,58,125,60);
  ssd1306_UpdateScreen();
}

void ssd1306_TestCircle() {
  uint32_t delta;

  for(delta = 0; delta < 5; delta ++) {
    ssd1306_DrawCircle(20*delta+30, 15, 10, White);
  }

  for(delta = 0; delta < 5; delta ++) {
    ssd1306_FillCircle(23*delta+15, 40, 10, White);
  }

  ssd1306_UpdateScreen();
  return;
}

void ssd1306_TestArc() {
  ssd1306_DrawArc(30, 30, 30, 20, 270, White);
  ssd1306_DrawArcWithRadiusLine(80, 55, 10, 30, 270, White);
  ssd1306_UpdateScreen();
  return;
}

void ssd1306_TestPolyline() {
  SSD1306_VERTEX loc_vertex[] =
  {
      {35,40},
      {40,20},
      {45,28},
      {50,10},
      {45,16},
      {50,10},
      {53,16}
  };

  ssd1306_Polyline(loc_vertex,sizeof(loc_vertex)/sizeof(loc_vertex[0]),White);
  ssd1306_UpdateScreen();
  return;
}

void ssd1306_TestDrawBitmap()
{
    ssd1306_Fill(White);
    ssd1306_DrawBitmap(0,0,garfield_128x64,128,64,Black);
    ssd1306_UpdateScreen();
    HAL_Delay(3000);
    ssd1306_Fill(Black);
    ssd1306_DrawBitmap(32,0,github_logo_64x64,64,64,White);
    ssd1306_UpdateScreen();
    HAL_Delay(3000);
    ssd1306_Fill(White);
    ssd1306_DrawBitmap(32,0,github_logo_64x64,64,64,Black);
    ssd1306_UpdateScreen();
}

// ___________________________________________________________________________________________________________________________________________________________
// DOUBLE PLAYER:

//void ssd1306_TestPongGame() {
//    ssd1306_Fill(Black);
//
//    // Ball properties
//    uint8_t ball_x = SSD1306_WIDTH / 2;
//    uint8_t ball_y = SSD1306_HEIGHT / 2;
//    int8_t ball_vx = 1;
//    int8_t ball_vy = 1;
//    const uint8_t ball_size = 4; // Increase ball size
//
//    // Paddle properties
//    const uint8_t paddle_width = 4; // Increase paddle width
//    const uint8_t paddle_height = 32; // Increase paddle height
//    uint8_t left_paddle_y = (SSD1306_HEIGHT - paddle_height) / 2;
//    uint8_t right_paddle_y = (SSD1306_HEIGHT - paddle_height) / 2;
//
//    // Define paddle movement direction
//    enum PaddleDirection {
//        UP,
//        DOWN
//    };
//
//    // Initialize paddle movement direction
//    enum PaddleDirection left_paddle_direction = DOWN;
//    enum PaddleDirection right_paddle_direction = UP;
//
//    // Game over flag
//    bool game_over = false;
//
//    // Main game loop
//    while (!game_over) {
//        // Clear previous ball position
//        ssd1306_FillRectangle(ball_x, ball_y, ball_x + ball_size, ball_y + ball_size, Black);
//        // Clear previous paddles positions
//        ssd1306_FillRectangle(0, left_paddle_y, paddle_width, left_paddle_y + paddle_height, Black);
//        ssd1306_FillRectangle(SSD1306_WIDTH - paddle_width, right_paddle_y, SSD1306_WIDTH, right_paddle_y + paddle_height, Black);
//
//        // Update ball position if game is not over
//        if (!game_over) {
//            ball_x += ball_vx;
//            ball_y += ball_vy;
//        }
//
//        // Ball collision with top and bottom screen borders
//        if (ball_y <= 0 || ball_y >= SSD1306_HEIGHT - ball_size) {
//            ball_vy = -ball_vy;
//        }
//
//        // Ball collision with paddles
//        if ((ball_x <= paddle_width && ball_y >= left_paddle_y && ball_y <= left_paddle_y + paddle_height) ||
//            (ball_x >= SSD1306_WIDTH - paddle_width - ball_size && ball_y >= right_paddle_y && ball_y <= right_paddle_y + paddle_height)) {
//            ball_vx = -ball_vx;
//        }
//
//        // Ball collision with left and right screen borders (scoring)
//        if (ball_x <= 0) {
//            // Game over, right player scores
//            game_over = true;
//        } else if (ball_x >= SSD1306_WIDTH - ball_size) {
//            // Game over, left player scores
//            game_over = true;
//        }
//
//        // Update paddles positions
//        // Move left paddle up and down
//        if (left_paddle_direction == UP) {
//            left_paddle_y--;
//            if (left_paddle_y <= 0) {
//                left_paddle_direction = DOWN;
//            }
//        } else {
//            left_paddle_y++;
//            if (left_paddle_y + paddle_height >= SSD1306_HEIGHT) {
//                left_paddle_direction = UP;
//            }
//        }
//        // Move right paddle up and down
//        if (right_paddle_direction == UP) {
//            right_paddle_y--;
//            if (right_paddle_y <= 0) {
//                right_paddle_direction = DOWN;
//            }
//        } else {
//            right_paddle_y++;
//            if (right_paddle_y + paddle_height >= SSD1306_HEIGHT) {
//                right_paddle_direction = UP;
//            }
//        }
//
//        // Draw new ball position if game is not over
//        if (!game_over) {
//            ssd1306_FillRectangle(ball_x, ball_y, ball_x + ball_size, ball_y + ball_size, White);
//        }
//
//        // Draw new paddles positions
//        ssd1306_FillRectangle(0, left_paddle_y, paddle_width, left_paddle_y + paddle_height, White);
//        ssd1306_FillRectangle(SSD1306_WIDTH - paddle_width, right_paddle_y, SSD1306_WIDTH, right_paddle_y + paddle_height, White);
//
//        // Update the screen
//        ssd1306_UpdateScreen();
//
//        // Delay to control the speed of the game
//        HAL_Delay(50); // Adjust as needed
//    }
//
//    // Display game over message
//    ssd1306_SetCursor(10, SSD1306_HEIGHT / 2 - 10);
//    ssd1306_WriteString("Game Over", Font_11x18, White);
//    ssd1306_UpdateScreen();
//
//    // Delay before restarting the game
//    HAL_Delay(2000); // Adjust as needed
//
//    // Reset ball position and velocity
//    ball_x = SSD1306_WIDTH / 2;
//    ball_y = SSD1306_HEIGHT / 2;
//    ball_vx = 1;
//    ball_vy = 1;
//
//    // Reset paddle positions
//    left_paddle_y = (SSD1306_HEIGHT - paddle_height) / 2;
//    right_paddle_y = (SSD1306_HEIGHT - paddle_height) / 2;
//
//    // Reset game over flag
//    game_over = false;
//
//    // Clear screen
//    ssd1306_Fill(Black);
//}
//_____________________________________________________________________________________________________________________________________________________


//____________________________________________________________________________________________________________________________________________________
//
//MOVING PADDLE WITH NO HIGH SCORE:

//void ssd1306_TestPongGame() {
//    ssd1306_Fill(Black);
//
//    // Ball properties
//    uint8_t ball_x = SSD1306_WIDTH / 2;
//    uint8_t ball_y = SSD1306_HEIGHT / 2;
//    int8_t ball_vx = 1;
//    int8_t ball_vy = 1;
//    const uint8_t ball_size = 4;
//
//    // Paddle properties
//    const uint8_t paddle_width = 32; // Paddle width
//    const uint8_t paddle_height = 4;  // Paddle height
//    uint8_t paddle_x = (SSD1306_WIDTH - paddle_width) / 2;
//    const uint8_t paddle_y = SSD1306_HEIGHT - paddle_height - 2;
//
//    // Game over flag
//    bool game_over = false;
//
//    // Main game loop
//    while (!game_over) {
//        // Clear previous ball position
//        ssd1306_FillRectangle(ball_x, ball_y, ball_x + ball_size, ball_y + ball_size, Black);
//        // Clear previous paddle position
//        ssd1306_FillRectangle(paddle_x, paddle_y, paddle_x + paddle_width, paddle_y + paddle_height, Black);
//
//        // Update ball position if game is not over
//        if (!game_over) {
//            ball_x += ball_vx;
//            ball_y += ball_vy;
//        }
//
//        // Ball collision with top and bottom screen borders
//        if (ball_y <= 0) {
//            ball_vy = -ball_vy;
//        }
//
//        // Ball collision with left and right screen borders
//        if (ball_x <= 0 || ball_x >= SSD1306_WIDTH - ball_size) {
//            ball_vx = -ball_vx;
//        }
//
//        // Ball collision with paddle
//        if (ball_y + ball_size >= paddle_y && ball_x + ball_size >= paddle_x && ball_x <= paddle_x + paddle_width) {
//            ball_vy = -ball_vy;
//        }
//
//        // Ball goes past the paddle (game over)
//        if (ball_y >= SSD1306_HEIGHT - ball_size) {
//            game_over = true;
//        }
//
//        // Update paddle position based on player input
//        // Assuming functions movePaddleLeft() and movePaddleRight() are defined elsewhere to handle button input
//        if (movePaddleLeft()) {
//            paddle_x -= 2; // Adjust speed as needed
//            if (paddle_x < 0) {
//                paddle_x = 0;
//            }
//        }
//        if (movePaddleRight()) {
//            paddle_x += 2; // Adjust speed as needed
//            if (paddle_x + paddle_width > SSD1306_WIDTH) {
//                paddle_x = SSD1306_WIDTH - paddle_width;
//            }
//        }
//
//        // Draw new ball position if game is not over
//        if (!game_over) {
//            ssd1306_FillRectangle(ball_x, ball_y, ball_x + ball_size, ball_y + ball_size, White);
//        }
//
//        // Draw new paddle position
//        ssd1306_FillRectangle(paddle_x, paddle_y, paddle_x + paddle_width, paddle_y + paddle_height, White);
//
//        // Update the screen
//        ssd1306_UpdateScreen();
//
//        // Delay to control the speed of the game
//        HAL_Delay(50); // Adjust as needed
//    }
//
//    // Display game over message
//    ssd1306_SetCursor(10, SSD1306_HEIGHT / 2 - 10);
//    ssd1306_WriteString("Game Over", Font_11x18, White);
//    ssd1306_UpdateScreen();
//
//    // Delay before restarting the game
//    HAL_Delay(2000); // Adjust as needed
//
//    // Reset ball position and velocity
//    ball_x = SSD1306_WIDTH / 2;
//    ball_y = SSD1306_HEIGHT / 2;
//    ball_vx = 1;
//    ball_vy = 1;
//
//    // Reset paddle position
//    paddle_x = (SSD1306_WIDTH - paddle_width) / 2;
//
//    // Reset game over flag
//    game_over = false;
//
//    // Clear screen
//    ssd1306_Fill(Black);
//}
//_____________________________________________________________________________________________________________________-


//void ssd1306_TestPongGame() {
//    ssd1306_Fill(Black);
//
//    // Constants for score display area
//    const uint8_t score_display_height = 16; // Adjust based on the font size
//    const uint8_t game_area_top = score_display_height + 2;
//
//    // Ball properties
//    uint8_t ball_x = SSD1306_WIDTH / 2;
//    uint8_t ball_y = (SSD1306_HEIGHT - game_area_top) / 2 + game_area_top;
//    int8_t ball_vx = 1;
//    int8_t ball_vy = 1;
//    const uint8_t ball_size = 4;
//
//    // Paddle properties
//    const uint8_t paddle_width = 32; // Paddle width
//    const uint8_t paddle_height = 4;  // Paddle height
//    uint8_t paddle_x = (SSD1306_WIDTH - paddle_width) / 2;
//    const uint8_t paddle_y = SSD1306_HEIGHT - paddle_height - 2;
//
//    // Game over flag
//    bool game_over = false;
//
//    // Score variables
//    int score = 0;
//    static int highscore = 0; // Use static to retain the value across multiple function calls
//
//    // Main game loop
//    while (!game_over) {
//        // Clear previous ball position
//        ssd1306_FillRectangle(ball_x, ball_y, ball_x + ball_size, ball_y + ball_size, Black);
//        // Clear previous paddle position
//        ssd1306_FillRectangle(paddle_x, paddle_y, paddle_x + paddle_width, paddle_y + paddle_height, Black);
//
//        // Update ball position if game is not over
//        if (!game_over) {
//            ball_x += ball_vx;
//            ball_y += ball_vy;
//        }
//
//        // Ball collision with top and bottom screen borders
//        if (ball_y <= game_area_top) {
//            ball_vy = -ball_vy;
//        }
//
//        // Ball collision with left and right screen borders
//        if (ball_x <= 0 || ball_x >= SSD1306_WIDTH - ball_size) {
//            ball_vx = -ball_vx;
//        }
//
//        // Ball collision with paddle
//        if (ball_y + ball_size >= paddle_y && ball_x + ball_size >= paddle_x && ball_x <= paddle_x + paddle_width) {
//            ball_vy = -ball_vy;
//            score++; // Increment score
//        }
//
//        // Ball goes past the paddle (game over)
//        if (ball_y >= SSD1306_HEIGHT - ball_size - paddle_height) {
//            game_over = true;
//        }
//
//        // Update paddle position based on player input
//        // Assuming functions movePaddleLeft() and movePaddleRight() are defined elsewhere to handle button input
//        if (movePaddleLeft()) {
//            paddle_x -= 2; // Adjust speed as needed
//            if (paddle_x < 0) {
//                paddle_x = SSD1306_WIDTH - paddle_width;
//            }
//        }
//        if (movePaddleRight()) {
//            paddle_x += 2; // Adjust speed as needed
//            if (paddle_x + paddle_width > SSD1306_WIDTH) {
//                paddle_x = 0;
//            }
//        }
//
//        // Draw new ball position if game is not over
//        if (!game_over) {
//            ssd1306_FillRectangle(ball_x, ball_y, ball_x + ball_size, ball_y + ball_size, White);
//        }
//
//        // Draw new paddle position
//        ssd1306_FillRectangle(paddle_x, paddle_y, paddle_x + paddle_width, paddle_y + paddle_height, White);
//
//        // Draw current score and high score
//        char score_str[10];
//        sprintf(score_str, "Score: %d", score);
//        ssd1306_SetCursor(0, 0);
//        ssd1306_WriteString(score_str, Font_6x8, White);
//
//        char highscore_str[15];
//        sprintf(highscore_str, "Highscore: %d", highscore);
//        ssd1306_SetCursor(0, 8);
//        ssd1306_WriteString(highscore_str, Font_6x8, White);
//
//        // Update the screen
//        ssd1306_UpdateScreen();
//
//        // Delay to control the speed of the game
//        HAL_Delay(50); // Adjust as needed
//    }
//
//    // Update high score if needed
//    if (score > highscore) {
//        highscore = score;
//    }
//
//    // Clear screen and display game over message
//    ssd1306_Fill(Black);
//    ssd1306_SetCursor(10, SSD1306_HEIGHT / 2 - 20);
//    ssd1306_WriteString("Game Over", Font_11x18, White);
//    ssd1306_UpdateScreen();
//
//    // Display the score
//    char score_str[10];
//    sprintf(score_str, "Score: %d", score);
//    ssd1306_SetCursor(10, SSD1306_HEIGHT / 2);
//    ssd1306_WriteString(score_str, Font_6x8, White);
//    ssd1306_UpdateScreen();
//
//    // Display the high score
//    char highscore_str[15];
//    sprintf(highscore_str, "Highscore: %d", highscore);
//    ssd1306_SetCursor(10, SSD1306_HEIGHT / 2 + 20);
//    ssd1306_WriteString(highscore_str, Font_6x8, White);
//    ssd1306_UpdateScreen();
//
//    // Delay before restarting the game
//    HAL_Delay(2000); // Adjust as needed
//
//    // Reset ball position and velocity
//    ball_x = SSD1306_WIDTH / 2;
//    ball_y = (SSD1306_HEIGHT - game_area_top) / 2 + game_area_top;
//    ball_vx = 1;
//    ball_vy = 1;
//
//    // Reset paddle position
//    paddle_x = (SSD1306_WIDTH - paddle_width) / 2;
//
//    // Reset game over flag
//    game_over = false;
//
//    // Reset score
//    score = 0;
//
//    // Clear screen
//    ssd1306_Fill(Black);
//
//}
//
//#include "stm32l4xx_hal.h"
//
//// Define the GPIO pins for left and right buttons
//#define LEFT_BUTTON_PIN GPIO_PIN_13
//#define RIGHT_BUTTON_PIN GPIO_PIN_4
//#define BUTTON_GPIO_PORT GPIOC
//
//// Variables to track button states
//bool wasLeftButtonPressed = false;
//bool wasRightButtonPressed = false;
//
//// Function to read the state of PC13
//GPIO_PinState readPC13State() {
//    return HAL_GPIO_ReadPin(GPIOC, LEFT_BUTTON_PIN);
//}
//
//// Function to read the state of PC4
//GPIO_PinState readPC4State() {
//    return HAL_GPIO_ReadPin(GPIOC, RIGHT_BUTTON_PIN);
//}
//
//// Function to move paddle left based on PC13 state
//bool movePaddleLeft(uint8_t *paddle_x) {
//    GPIO_PinState leftButtonState = readPC13State();
//    if (leftButtonState == GPIO_PIN_SET && !wasLeftButtonPressed) { // If PC13 is pressed and was not pressed before
//        wasLeftButtonPressed = true; // Update the button state
//        if (*paddle_x > 0) { // Ensure paddle doesn't go out of bounds
//            *paddle_x -= 2; // Move paddle left
//        }
//        return true; // Indicate paddle movement
//    }
//    if (leftButtonState == GPIO_PIN_RESET) {
//        wasLeftButtonPressed = false; // Reset the button state when not pressed
//    }
//    return false; // No paddle movement
//}
//
//// Function to move paddle right based on PC4 state
//bool movePaddleRight(uint8_t *paddle_x, uint8_t paddle_width) {
//    GPIO_PinState rightButtonState = readPC4State();
//    if (rightButtonState == GPIO_PIN_SET && !wasRightButtonPressed) { // If PC4 is pressed and was not pressed before
//        wasRightButtonPressed = true; // Update the button state
//        if (*paddle_x + paddle_width < SSD1306_WIDTH) { // Ensure paddle doesn't go out of bounds
//            *paddle_x += 2; // Move paddle right
//        }
//        return true; // Indicate paddle movement
//    }
//    if (rightButtonState == GPIO_PIN_RESET) {
//        wasRightButtonPressed = false; // Reset the button state when not pressed
//    }
//    return false; // No paddle movement
//}
//
//void ssd1306_TestPongGame() {
//    ssd1306_Fill(Black);
//
//    // Constants for score display area
//    const uint8_t score_display_height = 16; // Adjust based on the font size
//    const uint8_t game_area_top = score_display_height + 2;
//
//    // Ball properties
//    uint8_t ball_x = SSD1306_WIDTH / 2;
//    uint8_t ball_y = (SSD1306_HEIGHT - game_area_top) / 2 + game_area_top;
//    int8_t ball_vx = 1;
//    int8_t ball_vy = 1;
//    const uint8_t ball_size = 4;
//
//    // Paddle properties
//    const uint8_t paddle_width = 32; // Paddle width
//    const uint8_t paddle_height = 4;  // Paddle height
//    uint8_t paddle_x = (SSD1306_WIDTH - paddle_width) / 2; // Center the paddle initially
//    const uint8_t paddle_y = SSD1306_HEIGHT - paddle_height - 2;
//
//    // Game over flag
//    bool game_over = false;
//
//    // Score variables
//    int score = 0;
//    static int highscore = 0; // Use static to retain the value across multiple function calls
//
//    // Main game loop
//    while (!game_over) {
//        // Clear previous ball position
//        ssd1306_FillRectangle(ball_x, ball_y, ball_x + ball_size, ball_y + ball_size, Black);
//        // Clear previous paddle position
//        ssd1306_FillRectangle(paddle_x, paddle_y, paddle_x + paddle_width, paddle_y + paddle_height, Black);
//
//        // Update ball position if game is not over
//        if (!game_over) {
//            ball_x += ball_vx;
//            ball_y += ball_vy;
//        }
//
//        // Ball collision with top and bottom screen borders
//        if (ball_y <= game_area_top) {
//            ball_vy = -ball_vy;
//        }
//
//        // Ball collision with left and right screen borders
//        if (ball_x <= 0 || ball_x >= SSD1306_WIDTH - ball_size) {
//            ball_vx = -ball_vx;
//        }
//
//        // Ball collision with paddle
//        if (ball_y + ball_size >= paddle_y && ball_x + ball_size >= paddle_x && ball_x <= paddle_x + paddle_width) {
//            ball_vy = -ball_vy;
//            score++; // Increment score
//        }
//
//        // Ball goes past the paddle (game over)
//        if (ball_y >= SSD1306_HEIGHT - ball_size - paddle_height) {
//            game_over = true;
//        }
//
//        // Draw new ball position if game is not over
//        if (!game_over) {
//            ssd1306_FillRectangle(ball_x, ball_y, ball_x + ball_size, ball_y + ball_size, White);
//        }
//
//        // Draw new paddle position based on player input
//        if (movePaddleLeft(&paddle_x)) {
//            // Nothing additional needed
//        }
//        if (movePaddleRight(&paddle_x, paddle_width)) {
//            // Nothing additional needed
//        }
//
//        // Draw new paddle position
//        ssd1306_FillRectangle(paddle_x, paddle_y, paddle_x + paddle_width, paddle_y + paddle_height, White);
//
//        // Draw current score and high score
//        char score_str[10];
//        sprintf(score_str, "Score: %d", score);
//        ssd1306_SetCursor(0, 0);
//        ssd1306_WriteString(score_str, Font_6x8, White);
//
//        char highscore_str[15];
//        sprintf(highscore_str, "Highscore: %d", highscore);
//        ssd1306_SetCursor(0, 8);
//        ssd1306_WriteString(highscore_str, Font_6x8, White);
//
//        // Update the screen
//        ssd1306_UpdateScreen();
//
//        // Delay to control the speed of the game
//        HAL_Delay(50); // Adjust as needed
//    }
//
//    // Update high score if needed
//    if (score > highscore) {
//        highscore = score;
//    }
//
//    // Clear screen and display game over message
//    ssd1306_Fill(Black);
//    ssd1306_SetCursor(10, SSD1306_HEIGHT / 2 - 20);
//    ssd1306_WriteString("Game Over", Font_11x18, White);
//    ssd1306_UpdateScreen();
//
//    // Display the score
//    char score_str[10];
//    sprintf(score_str, "Score: %d", score);
//    ssd1306_SetCursor(10, SSD1306_HEIGHT / 2);
//    ssd1306_WriteString(score_str, Font_6x8, White);
//    ssd1306_UpdateScreen();
//
//    // Display the high score
//    char highscore_str[15];
//    sprintf(highscore_str, "Highscore: %d", highscore);
//    ssd1306_SetCursor(10, SSD1306_HEIGHT / 2 + 20);
//    ssd1306_WriteString(highscore_str, Font_6x8, White);
//    ssd1306_UpdateScreen();
//
//    // Delay before restarting the game
//    HAL_Delay(2000); // Adjust as needed
//
//    // Reset ball position and velocity
//    ball_x = SSD1306_WIDTH / 2;
//    ball_y = (SSD1306_HEIGHT - game_area_top) / 2 + game_area_top;
//    ball_vx = 1;
//    ball_vy = 1;
//
//    // Reset paddle position
//    paddle_x = (SSD1306_WIDTH - paddle_width) / 2;
//
//    // Reset game over flag
//    game_over = false;
//
//    // Reset score
//    score = 0;
//
//    // Clear screen
//    ssd1306_Fill(Black);
//}


//________________________________________________________________________________________________________________________
//
//STATIC PADDLE CODE:

//#include "stm32l4xx_hal.h"
//
//void ssd1306_TestPongGame() {
//    ssd1306_Fill(Black);
//
//    // Ball properties
//    uint8_t ball_x = SSD1306_WIDTH / 2;
//    uint8_t ball_y = SSD1306_HEIGHT / 2;
//    int8_t ball_vx = 1;
//    int8_t ball_vy = 1;
//    const uint8_t ball_size = 4;
//
//    // Paddle properties
//    const uint8_t paddle_width = 32; // Paddle width
//    const uint8_t paddle_height = 4;  // Paddle height
//    uint8_t paddle_x = (SSD1306_WIDTH - paddle_width) / 2;
//    const uint8_t paddle_y = SSD1306_HEIGHT - paddle_height - 2;
//
//    // Game over flag
//    bool game_over = false;
//
//    // Main game loop
//    while (!game_over) {
//        // Clear previous ball position
//        ssd1306_FillRectangle(ball_x, ball_y, ball_x + ball_size, ball_y + ball_size, Black);
//        // Clear previous paddle position
//        ssd1306_FillRectangle(paddle_x, paddle_y, paddle_x + paddle_width, paddle_y + paddle_height, Black);
//
//        // Update ball position if game is not over
//        if (!game_over) {
//            ball_x += ball_vx;
//            ball_y += ball_vy;
//        }
//
//        // Ball collision with top and bottom screen borders
//        if (ball_y <= 0) {
//            ball_vy = -ball_vy;
//        }
//
//        // Ball collision with left and right screen borders
//        if (ball_x <= 0 || ball_x >= SSD1306_WIDTH - ball_size) {
//            ball_vx = -ball_vx;
//        }
//
//        // Ball collision with paddle
//        if (ball_y + ball_size >= paddle_y && ball_x + ball_size >= paddle_x && ball_x <= paddle_x + paddle_width) {
//            ball_vy = -ball_vy;
//        }
//
//        // Ball goes past the paddle (game over)
//        if (ball_y >= SSD1306_HEIGHT - ball_size) {
//            game_over = true;
//        }
//
//        // Draw new ball position if game is not over
//        if (!game_over) {
//            ssd1306_FillRectangle(ball_x, ball_y, ball_x + ball_size, ball_y + ball_size, White);
//        }
//
//        // Draw paddle position
//        ssd1306_FillRectangle(paddle_x, paddle_y, paddle_x + paddle_width, paddle_y + paddle_height, White);
//
//        // Update the screen
//        ssd1306_UpdateScreen();
//
//        // Delay to control the speed of the game
//        HAL_Delay(50); // Adjust as needed
//    }
//
//    // Display game over message
//    ssd1306_SetCursor(10, SSD1306_HEIGHT / 2 - 10);
//    ssd1306_WriteString("Game Over", Font_11x18, White);
//    ssd1306_UpdateScreen();
//
//    // Delay before restarting the game
//    HAL_Delay(2000); // Adjust as needed
//
//    // Reset ball position and velocity
//    ball_x = SSD1306_WIDTH / 2;
//    ball_y = SSD1306_HEIGHT / 2;
//    ball_vx = 1;
//    ball_vy = 1;
//
//    // Reset paddle position
//    paddle_x = (SSD1306_WIDTH - paddle_width) / 2;
//
//    // Reset game over flag
//    game_over = false;
//
//    // Clear screen
//    ssd1306_Fill(Black);
//}

//
//________________________________________________________________________________________________________________________


//_________________________________________________________________________________________________________________________
// with buttons motion Sattic PAddle:



//__________________________________________________________________________________________________________________________

void ssd1306_TestAll() {
    ssd1306_Init();

    ssd1306_TestFPS();
    HAL_Delay(3000);
    ssd1306_TestBorder();
    ssd1306_TestFonts1();
    HAL_Delay(3000);
    ssd1306_TestFonts2();
    HAL_Delay(3000);
    ssd1306_TestFonts3();
    HAL_Delay(3000);
    ssd1306_Fill(Black);
    ssd1306_TestRectangle();
    ssd1306_TestLine();
    HAL_Delay(3000);
    ssd1306_Fill(Black);
    ssd1306_TestRectangleFill();
    HAL_Delay(3000);
    ssd1306_Fill(Black);
    ssd1306_TestRectangleInvert();
    HAL_Delay(3000);
    ssd1306_Fill(Black);
    ssd1306_TestPolyline();
    HAL_Delay(3000);
    ssd1306_Fill(Black);
    ssd1306_TestArc();
    HAL_Delay(3000);
    ssd1306_Fill(Black);
    ssd1306_TestCircle();
    HAL_Delay(3000);
    ssd1306_TestDrawBitmap();
    HAL_Delay(3000);

//    // Call the pong ball animation
//    ssd1306_TestPongGame();
//    HAL_Delay(3000);
    ssd1306_TestPongGame();
}




